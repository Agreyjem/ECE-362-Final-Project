// audio.c - Beyblade sound engine for the Proton (RP2350) board.
//
// GP36 runs PWM at ~146 kHz and its duty cycle is updated 8000 times per
// second, so with the board's RC filter it works like a DAC: it plays the
// real recorded collision sounds and square-wave melodies, each with its own
// volume, from the same pin.

#include <stdlib.h>
#include "pico/stdlib.h"
#include "hardware/pwm.h"
#include "audio.h"

#define AUDIO_PIN   36
#define SAMPLE_RATE 8000    // samples per second (125 us each)

// >>> VOLUMES (0-100). Collisions are set louder than the melodies.
static volatile int melody_volume  = 12;   // 100 = as loud as the original beeps
static volatile int collide_volume = 100;

// ======================= Melodies =======================
typedef struct { uint16_t freq, ms; } note_t;   // freq 0 = rest

static const note_t START[]  = { {523,200},{0,800}, {523,200},{0,800}, {523,200},{0,800}, {1047,700} };
static const note_t WINNER[] = { {392,120},{523,120},{659,120},{784,240},{0,60},{659,120},{784,600} };
static const note_t LOSER[]  = { {392,350},{0,50}, {370,350},{0,50}, {349,350},{0,50}, {330,900} };

// ======================= Collision sounds =======================
// Six real hits from a recording (filtered to 300 Hz-3 kHz, lightly compressed
// so the ring stays loud), 8-bit, 8000 Hz. The data is at the bottom of this file.
typedef struct { const int8_t *data; uint16_t len; } hit_t;
extern const hit_t HITS[];
extern const unsigned NUM_HITS;

// ======================= Player =======================
static const note_t *volatile notes;     // melody playing (NULL = none)
static int notes_left;
static uint32_t note_left, phase, phase_inc;
static bool note_on;

static const int8_t *volatile hit;       // hit playing (NULL = none)
static int hit_pos, hit_len, hit_gain, last_hit = -1;

// Called 8000 times per second: outputs one sample
static bool audio_tick(struct repeating_timer *t) {
    (void)t;
    int s = 0;
    if (hit) {
        s = hit[hit_pos] * hit_gain / 100 * collide_volume / 100;
        if (++hit_pos >= hit_len) hit = NULL;
    } else if (notes) {
        if (note_left == 0) {
            if (notes_left == 0) { notes = NULL; goto out; }
            const note_t *n = notes++;
            notes_left--;
            note_left = n->ms * SAMPLE_RATE / 1000;
            phase_inc = (uint32_t)(((uint64_t)n->freq << 32) / SAMPLE_RATE);
            note_on = n->freq != 0;
        }
        note_left--;
        if (note_on) s = ((phase += phase_inc) & 0x80000000u) ? 127 : -127;
        s = s * melody_volume / 100;
    }
out:
    pwm_set_gpio_level(AUDIO_PIN, 512 + s * 4);        // 0-1023
    return true;
}

static void play_notes(const note_t *n, int count) {
    notes = NULL; hit = NULL;                          // stop whatever is playing
    notes_left = count; note_left = 0;
    notes = n;
}

static int clamp100(int v) { return v < 0 ? 0 : v > 100 ? 100 : v; }

// ======================= Public functions =======================
void sound_init(void) {
    gpio_set_function(AUDIO_PIN, GPIO_FUNC_PWM);
    uint slice = pwm_gpio_to_slice_num(AUDIO_PIN);
    pwm_set_wrap(slice, 1023);                         // 10-bit, 150 MHz / 1024 = 146 kHz
    pwm_set_enabled(slice, true);
    for (int l = 0; l <= 512; l += 4) {                // ramp to the silence level: no pop
        pwm_set_gpio_level(AUDIO_PIN, l);
        sleep_us(200);
    }
    srand(time_us_32());
    static struct repeating_timer timer;
    add_repeating_timer_us(-1000000 / SAMPLE_RATE, audio_tick, NULL, &timer);
}

void play_start(void)  { play_notes(START,  sizeof(START)  / sizeof(note_t)); }
void play_winner(void) { play_notes(WINNER, sizeof(WINNER) / sizeof(note_t)); }
void play_loser(void)  { play_notes(LOSER,  sizeof(LOSER)  / sizeof(note_t)); }

// Random recorded hit (never the same one twice in a row), 80-100% loudness.
// Ignored while a melody is playing, so it can't cut off the countdown or fanfare.
void play_collide(void) {
    if (notes) return;
    int h;
        
    if (last_hit < 0) {
        h = rand() % (int)NUM_HITS;                    // first hit: any of them
    } else {
        h = rand() % ((int)NUM_HITS - 1);              // pick from the other 5...
        if (h >= last_hit) h++;                        // ...by skipping over the last one
    }
    
    last_hit = h;
    hit = NULL;
    hit_pos = 0;
    hit_len = HITS[h].len;
    hit_gain = 80 + rand() % 21;
    hit = HITS[h].data;
}

bool sound_is_playing() {
    return (notes || hit); 
}
void sound_wait() { 
    while (sound_is_playing()) 
        tight_loop_contents(); 
}

void sound_set_volume(int melody, int collide) {
    melody_volume  = clamp100(melody);
    collide_volume = clamp100(collide);
}

// ======================= Collision audio data =======================

static const int8_t hit_a[] = {
    0,-2,-5,1,24,23,-39,-32,28,-10,-21,12,-22,-1,39,-29,1,97,-9,-94,65,96,-52,-73,
    21,45,11,-55,-67,23,65,-20,-76,-3,71,35,-33,-48,-5,55,36,-62,-47,73,64,-44,-48,21,
    42,26,-25,-60,12,59,-27,-65,-2,30,9,-24,-36,8,47,1,-48,-1,51,17,-19,7,30,17,
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    -1,-1,0,0,0,0,0,0,
};
static const int8_t hit_b[] = {
    0,2,3,-6,-4,6,-6,-13,2,0,-13,4,4,-38,-12,39,9,-5,4,12,39,-19,-59,26,
    56,33,13,-61,-53,68,76,-26,-120,-70,87,112,-25,-127,-62,77,97,10,-71,-50,40,57,-7,-48,
    2,48,4,-42,-24,19,32,-20,-49,7,55,31,-34,-46,12,51,-5,-62,-4,78,50,-62,-95,-3,
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    -1,-3,-1,2,1,-1,0,1,1,-1,-1,-1,0,0,0,0,
};
static const int8_t hit_c[] = {
    0,1,-8,-3,13,4,-17,-12,9,15,-3,-17,5,26,-10,-24,23,30,-2,-19,-19,10,14,-48,
    -39,68,67,-58,-67,44,51,-28,-59,-17,75,63,-52,-59,37,58,-29,-77,-1,73,31,-43,-44,19,
    48,-16,-62,-3,54,23,-27,-27,7,30,-1,-38,-5,34,15,-9,-10,-1,14,15,-5,-20,-4,14,
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    0,0,0,1,0,-1,0,0,0,0,-1,0,0,0,0,0,
};
static const int8_t hit_d[] = {
    0,1,6,-2,-11,-6,10,20,-1,-24,0,28,5,-6,-5,-10,27,16,-54,-30,50,28,-31,-41,
    -4,52,25,-62,-44,48,51,-9,-51,-30,46,40,-28,-30,17,39,10,-31,-28,18,43,1,-50,-30,
    26,23,-14,-20,8,26,14,-7,-22,7,24,-14,-31,-4,16,6,-7,-9,4,13,4,-9,-6,11,
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    0,-1,1,1,0,-1,0,0,0,0,-1,0,0,0,0,0,
};
static const int8_t hit_e[] = {
    0,0,3,4,4,-5,-9,-1,5,-7,-13,-2,17,24,-7,-24,13,33,6,-28,-30,21,27,-9,
    -23,-22,10,26,-36,-57,1,48,44,8,-7,16,42,-11,-70,-21,49,27,-48,-49,16,33,9,-23,
    -21,38,66,8,-42,-34,-14,22,2,-43,-23,31,37,-17,-28,6,31,38,-27,-72,11,77,40,-23,
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    1,0,-1,0,1,0,0,0,0,0,0,0,0,0,0,0,
};
static const int8_t hit_f[] = {
    0,0,-1,5,12,10,9,-2,-21,-23,-13,19,38,8,-4,11,-6,-33,-52,-24,47,43,-11,-2,
    13,-66,-38,89,66,-72,-75,38,80,30,-89,-82,44,127,70,-112,-104,38,75,69,-16,-118,-24,73,
    54,5,-82,-58,74,66,-54,-67,6,72,54,-54,-71,26,67,10,-52,-44,45,62,-21,-60,-10,52,
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    1,-1,-2,0,1,0,-1,0,0,0,0,0,0,1,0,0,0,0,0,0,0,0,0,0,
};

const hit_t HITS[] = {
    {hit_a, sizeof(hit_a)}, {hit_b, sizeof(hit_b)}, {hit_c, sizeof(hit_c)},
    {hit_d, sizeof(hit_d)}, {hit_e, sizeof(hit_e)}, {hit_f, sizeof(hit_f)},
};
const unsigned NUM_HITS = sizeof(HITS) / sizeof(HITS[0]);